// #include "libs/adc/api.h"
// #include "libs/can/api.h"
// #include "libs/gpio/api.h"
// #include "libs/timer/api.h"

// #include "throttle_config.h"
// #include "vehicle/mkvii/software/lv/throttle/can_api.h"

// #include <avr/interrupt.h>
// #include <stdbool.h>
// #include <stdint.h>
// #include <stdlib.h>
// #include <sys/types.h>
// #include <util/delay.h>

// // commented out temporarily for Jack's testing
// #include "projects/btldr/btldr_lib.h"
// #include "projects/btldr/git_sha.h"
// #include "projects/btldr/libs/image/api.h"


#include "vcu.h"
#include "vcu_config.h"
#include "gpio.h"
#include "adc.h"
#include "fdcan.h"
#include "stm32g441xx.h"
#include "stm32g4xx_hal_adc.h"
#include "stm32g4xx_hal_rcc.h"
#include "stm32g4xx_hal_pwr_ex.h"
#include "stm32g4xx_hal_flash.h"

static vcu_state_s state = { 0 };


void ErrorHandler(void) { // this will only happen if error on board
    __disable_irq();
    while (1) {
    }
}

void SystemClockConfig(void) { // if you are messing with this please consult someone
  RCC_OscInitTypeDef RCC_OscInitStruct = {0};
  RCC_ClkInitTypeDef RCC_ClkInitStruct = {0};

  HAL_PWREx_ControlVoltageScaling(PWR_REGULATOR_VOLTAGE_SCALE1);

  RCC_OscInitStruct.OscillatorType = RCC_OSCILLATORTYPE_HSE;
  RCC_OscInitStruct.HSEState = RCC_HSE_ON;
  RCC_OscInitStruct.PLL.PLLState = RCC_PLL_ON;
  RCC_OscInitStruct.PLL.PLLSource = RCC_PLLSOURCE_HSE;
  RCC_OscInitStruct.PLL.PLLM = RCC_PLLM_DIV1;
  RCC_OscInitStruct.PLL.PLLN = 8;
  RCC_OscInitStruct.PLL.PLLP = RCC_PLLP_DIV2;
  RCC_OscInitStruct.PLL.PLLQ = RCC_PLLQ_DIV2;
  RCC_OscInitStruct.PLL.PLLR = RCC_PLLR_DIV2;

  if (HAL_RCC_OscConfig(&RCC_OscInitStruct) != HAL_OK) {
    ErrorHandler();
  }

  RCC_ClkInitStruct.ClockType = RCC_CLOCKTYPE_HCLK|RCC_CLOCKTYPE_SYSCLK
                              |RCC_CLOCKTYPE_PCLK1|RCC_CLOCKTYPE_PCLK2;
  RCC_ClkInitStruct.SYSCLKSource = RCC_SYSCLKSOURCE_PLLCLK;
  RCC_ClkInitStruct.AHBCLKDivider = RCC_SYSCLK_DIV1;
  RCC_ClkInitStruct.APB1CLKDivider = RCC_HCLK_DIV1;
  RCC_ClkInitStruct.APB2CLKDivider = RCC_HCLK_DIV1;

  if (HAL_RCC_ClockConfig(&RCC_ClkInitStruct, FLASH_LATENCY_2) != HAL_OK) {
    ErrorHandler();
  }
}

/**
  * @brief System Clock Configuration Generated by CubeMX, verification required
  * @retval None
  */
// void SystemClock_Config(void)
// {
//   RCC_OscInitTypeDef RCC_OscInitStruct = {0};
//   RCC_ClkInitTypeDef RCC_ClkInitStruct = {0};

//   /** Configure the main internal regulator output voltage
//   */
//   HAL_PWREx_ControlVoltageScaling(PWR_REGULATOR_VOLTAGE_SCALE1);

//   /** Initializes the RCC Oscillators according to the specified parameters
//   * in the RCC_OscInitTypeDef structure.
//   */
//   RCC_OscInitStruct.OscillatorType = RCC_OSCILLATORTYPE_HSI;
//   RCC_OscInitStruct.HSIState = RCC_HSI_ON;
//   RCC_OscInitStruct.HSICalibrationValue = RCC_HSICALIBRATION_DEFAULT;
//   RCC_OscInitStruct.PLL.PLLState = RCC_PLL_NONE;
//   if (HAL_RCC_OscConfig(&RCC_OscInitStruct) != HAL_OK)
//   {
//     Error_Handler();
//   }

//   /** Initializes the CPU, AHB and APB buses clocks
//   */
//   RCC_ClkInitStruct.ClockType = RCC_CLOCKTYPE_HCLK|RCC_CLOCKTYPE_SYSCLK
//                               |RCC_CLOCKTYPE_PCLK1|RCC_CLOCKTYPE_PCLK2;
//   RCC_ClkInitStruct.SYSCLKSource = RCC_SYSCLKSOURCE_HSI;
//   RCC_ClkInitStruct.AHBCLKDivider = RCC_SYSCLK_DIV1;
//   RCC_ClkInitStruct.APB1CLKDivider = RCC_HCLK_DIV1;
//   RCC_ClkInitStruct.APB2CLKDivider = RCC_HCLK_DIV1;

//   if (HAL_RCC_ClockConfig(&RCC_ClkInitStruct, FLASH_LATENCY_0) != HAL_OK)
//   {
//     Error_Handler();
//   }
// }

void SysTick_Handler(void) {
  HAL_IncTick();
}

void update_Error_LED(void) {
    if (throttle_debug.throttle_l_out_of_range || throttle_debug.throttle_r_out_of_range
    || throttle_debug.throttle_deviation || throttle_debug.throttle_brake_implaus) {
        gpio_set_pin(ERROR_LED);
    } else {
        gpio_clear_pin(ERROR_LED);
    }
}

// void update_Heartbeat_LED(void) {
//     heartbeat_counter += 1;
//     if (heartbeat_counter == 50) {
//         gpio_toggle_pin(HEARTBEAT_LED);
//         throttle.heartbeat = !throttle.heartbeat;
//         heartbeat_counter = 0;
//     }
// }

/*
    Read value from throttle potentiometer, maps it to value between 0 and
    255 where 255 = 100% throttle
    Takes in bool for whether the read throttle is the left or not for
    debugging purposes
    Returns an int16_t representing pedal travel
*/
static int16_t get_throttle_travel(ADC_HandleTypeDef* hadc_apps1) {
    int16_t throttle_raw = adc_read(throttle->adc_pin);
    if (is_left_throttle) {
        throttle_debug.throttle_l_raw = throttle_raw;
    } else {
        throttle_debug.throttle_r_raw = throttle_raw;
    }
    throttle_raw >>= 2;
    int16_t range = throttle->throttle_max - throttle->throttle_min;
    int32_t scaled_pos
        = (int32_t)(throttle_raw - throttle->throttle_min) * MAX_THROTTLE_POS;

    // Preserve floor() behavior for negative values while avoiding float math.
    if (scaled_pos < 0) {
        return -(int16_t)((-scaled_pos + range - 1) / range);
    }

    return (int16_t)(scaled_pos / range);
}

/*
    Check if sensors return a value out of range (<0 or >255)
    Args:
        pos_l: int16_t sensor value of throttle pot 1eft
        pos_r: int16_t sensor value of throttle pot right
    Returns:
        implausibility: boolean if throttle out of range or not
*/
static bool check_out_of_range(int16_t* pos_l, int16_t* pos_r) {
    bool implausibility = false; 

    // Check 1st pot
    if (*pos_l > MAX_THROTTLE_POS) {
        *pos_l = MAX_THROTTLE_POS;
        throttle_debug.throttle_l_out_of_range = true;
        implausibility = true;
    } else if (*pos_l < MIN_THROTTLE_POS) {
        *pos_l = MIN_THROTTLE_POS;
        throttle_debug.throttle_l_out_of_range = true;
        implausibility = true;
    } else {
        throttle_debug.throttle_l_out_of_range = false;
    }

    // Check 2nd pot
    if (*pos_r > MAX_THROTTLE_POS) {
        *pos_r = MAX_THROTTLE_POS;
        throttle_debug.throttle_r_out_of_range = true;
        implausibility = true;
    } else if (*pos_r < MIN_THROTTLE_POS) {
        *pos_r = MIN_THROTTLE_POS;
        throttle_debug.throttle_r_out_of_range = true;
        implausibility = true;
    } else {
        // Will be reset if Ready to Drive is not on
        throttle_debug.throttle_r_out_of_range = false;
    }
    return implausibility;
}

/*
    Check for deviation between 2 throttle sensors, >10% deviation is an
    implausibility
    Args:
        pos_min: int16_t bigger sensor value of the 2 throttle pots
        pos_max: int16_t smaller sensor value of the 2 throttle pots
    Returns:
        boolean if there's deviation or not
*/
static bool check_deviation(int16_t pos_max, int16_t pos_min) {
    if (pos_max - pos_min > APPS_IMPLAUSIBILITY_DEVIATION_THRESHOLD) {
        throttle_debug.throttle_deviation = true;
        return true;
    } else {
        throttle_debug.throttle_deviation = false;
        return false;
    }
}

/*
    Check if brakes are on while pedal travel >= 25%, if so return
    implausibility If pedal travel becomes <5%, clear implausibility.
    Args:
        pos_min: int16_t smaller sensor value of the 2 pots
    Returns:
        true if implausibility, false if not
*/
static bool check_brake(int16_t pos_min) {
    // bool brake_implausibility_occurred = false;

    if (throttle_state.brake_pressed) {
        // if brakes are pressed
        if (pos_min >= APPS_BRAKE_IMPLAUSIBILITY_THRESHOLD) {
            // brake is pressed, pedal travel >= 25%
            // brake_implausibility_occurred = true;
            throttle_debug.throttle_brake_implaus = true;
            return true;
        } else if (throttle_debug.throttle_brake_implaus && pos_min >= APPS_BRAKE_IMPLAUSIBILITY_THRESHOLD_LOW){
            // if there has 
            return true;
        } else {
            // if brake is pressed and no implausibility
            // brake_implausibility_occurred = false;
            throttle_debug.throttle_brake_implaus = false;
            return false;
        }

    } else {
        // brakes are not pressed
        if (throttle_debug.throttle_brake_implaus) {
            // but implausibility prev occurred
            if (pos_min <= APPS_BRAKE_IMPLAUSIBILITY_THRESHOLD_LOW) {
                // however pedal is <= 5% travel, no implausibility
                // brake_implausibility_occurred = false;
                throttle_debug.throttle_brake_implaus = false;
                return false;
            } else {
                // else pedal travel still >5%
                throttle_debug.throttle_brake_implaus = true;
                return true;
            }
        } else {
            // brake not pressed, no prev implausibility
            throttle_debug.throttle_brake_implaus = false;
            return false;
        }
    }
}

int main(void) {
    // sei();

    // can_init_throttle();
    // adc_init();

    // timer_init(&timer0_cfg);
    // timer_init(&timer1_cfg);

    // updater_init(BTLDR_ID, 5);
    // gpio_set_mode(SS_IS, INPUT);
    // // gpio_set_mode(HEARTBEAT_LED, OUTPUT);
    // gpio_set_mode(ERROR_LED, OUTPUT);
    // gpio_enable_interrupt(SS_IS);

    // throttle.throttle_status = THROTTLE_IDLE;

    // pcint0_callback();

    /* Reset of all peripherals, Initializes the Flash interface and the Systick. */
    HAL_Init();

    /* Configure the system clock */
    SystemClock_Config();

    /* Initialize all configured peripherals */
    GPIO_Init();
    ADC1_Init();
    // ADC2_Init(); // Not using for throttle
    // FDCAN1_Init(); // Temporarily disabled

    /*
     * This feature is added so that the inverter cannot be accidentally enabled
     * when first powered up. This feature requires that before sending out an
     * Inverter Enable command, the user must send out an Inverter Disable
     * command. Once the inverter sees a Disable command, the lockout is removed
     * and controller can receive the Inverter Enable command
     */
    // can_send_m192_command_message();

    // m192_command_message.direction_command = MOTOR_ANTICLOCKWISE;

    // can_receive_bspd();
    // can_receive_dashboard();

    while (true) {
        HAL_Delay(1000);
        HAL_GPIO_TogglePin(VCU_HEARTBEAT_LED_GPIO_PORT, VCU_HEARTBEAT_LED_GPIO_PIN);
    //     updater_loop();
    //     if (run_1ms) {
    //         run_1ms = false;

    //         if (can_poll_receive_bspd() == 0) {
    //             // checking brake status
    //             throttle_state.brake_pressed = bspd.brake_gate;
    //             can_receive_bspd();
    //         }

    //         if (can_poll_receive_dashboard() == 0) {
    //             // check RTD status
    //             can_receive_dashboard();
    //             m192_command_message.inverter_enable = dashboard.ready_to_drive;
    //         }

    //         int16_t pos_l = get_throttle_travel(&throttle_l, true);
    //         int16_t pos_r = get_throttle_travel(&throttle_r, false);
    //         int16_t pos_min = MIN(pos_l, pos_r);
    //         int16_t pos_max = MAX(pos_l, pos_r);

    //         throttle.throttle_l_pos = pos_l;
    //         throttle.throttle_r_pos = pos_r;

    //         // checking implausibilities
            
    //         bool oor_implausibility;

    //         if (check_out_of_range(&pos_l, &pos_r)) { // if out of range value is true,
    //             oor_implausibility = true;
    //             // first check if left_throttle debug has been triggered 
    //             if (throttle_debug.throttle_l_out_of_range) {
    //                 throttle.throttle_status = THROTTLE_L_OUT_OF_RANGE;
    //             }
    //             // do the same with the right throttle
    //             if (throttle_debug.throttle_r_out_of_range) {
    //                 throttle.throttle_status = THROTTLE_R_OUT_OF_RANGE;
    //                }
    //         } else {
    //             // if nothing is triggered, oor_implaus is not triggered
	// 	        oor_implausibility = false;
    //         }

    //         bool deviation_implausibility;

    //         if (check_deviation(pos_max, pos_min)) {
    //             deviation_implausibility = true;
    //             throttle.throttle_status = THROTTLE_POSITION_IMPLAUSIBILITY;
    //         } else {
    //         	deviation_implausibility = false;
    //         }

    //         update_Error_LED();
            
    //         if (check_brake(pos_min)) {
    //             SET_TORQUE_REQUEST(0);
    //             throttle.throttle_status = THROTTLE_BRAKE_PRESSED;
    //             update_Error_LED();
    //             continue;
    //         }

    //         if (oor_implausibility || deviation_implausibility) {
    //             throttle_state.implausibility_fault_counter++;
    //             if (throttle_state.implausibility_fault_counter
    //                 >= IMPLAUSIBILITY_TIME_LIMIT) {
    //                 /*
    //                 if timer reaches IMPLAUSIBILITY_TIMEOUT, request 0 torque
    //                 */
    //                 SET_TORQUE_REQUEST(0);
    //                 throttle_state.implausibility_fault_counter = 0;
    //             }
    //             continue;

    //         } else {
    //             throttle.throttle_status = THROTTLE_RUN;
    //             throttle_state.implausibility_fault_counter = 0;
    //             update_Error_LED();

    //             // NOTE: If we decide to do a non-linear map, that would go here
    //             int16_t torque_request = pos_min * TORQUE_REQUEST_SCALE;

    //             //Prevent motor whining while idle
    //             if(torque_request < 20) {
    //                 torque_request = 0;
    //             }
    //             if(torque_request > 2300) {
    //                 torque_request = 2540;
    //             }

    //             SET_TORQUE_REQUEST(torque_request);
    //         }

    //         if (!dashboard.ready_to_drive) {
    //             SET_TORQUE_REQUEST(0);
    //             throttle.throttle_status = THROTTLE_IDLE;
    //             continue;
    //         }
    //     }

    //     if (throttle_state.send_can) {
    //         can_send_throttle();
    //         can_send_throttle_debug();
    //         can_send_m192_command_message();
    //         // update_Heartbeat_LED();
    //         throttle_state.send_can = false;
    //     }
    }
}


// Helper functions

/*
    Replacing: 
    #define MIN(a, b) (((a) < (b)) ? (a) : (b))
    #define MAX(a, b) (((a) > (b)) ? (a) : (b))

    Because according to Gemini:
    static inline functions are generally superior to macros because they provide 
    type safety, allow for easier debugging, and avoid the "double evaluation" side 
    effect where an expression like i++ might be executed twice. While macros are 
    simple text replacements, static inline functions are handled by the compiler, 
    ensuring that your uint16_t logic is both robust and as performant as a macro 
    after optimization.
*/

static inline uint16_t vcu_min_u16(uint16_t a, uint16_t b) {
    return (a < b) ? a : b;
}

static inline uint16_t vcu_abs_diff_u16(uint16_t a, uint16_t b) {
    return (a > b) ? (uint16_t)(a - b) : (uint16_t)(b - a);
}

static inline uint16_t vcu_increment_sat_u16(uint16_t value) {
    return (value == UINT16_MAX) ? UINT16_MAX : (uint16_t)(value + 1u);
}